;
; button_ver_02.asm
;
; Created: 14.01.2026 23:13:47
; Author : ar_user
;
.include "m8def.inc"
.list
.include "define.inc"	; Наши все определения переменных тут

.cseg
; =========== Векторы прерывания ===========
	.ORG 	0x0000			; Проц стартует с нуля, но дальше идут вектора 
	RJMP 	Reset			; прерываний, поэтому отсюда сразу же прыгаем на начало программы. На метку Reset
	/*.ORG	0x0001			; External Interrupt Request 0 = 0x0001
	RJMP 	INT0_DS3231		; Вектор INT0 (DS3231)*/
	.ORG	0x0002			; External Interrupt Request 1 = 0x0001
	RJMP 	INT1_ISR		; Вектор INT1
	.ORG	0x0009			; Timer/Counter0 Overflow
	RJMP 	TIMER0_ISR			; Вектор  TIMER0 OVF
.org 0x0020

; =========== Таблицы ===========
SEG_TABLE:
    .db SEG_0, SEG_1, SEG_2, SEG_3, SEG_4, SEG_5, SEG_6, SEG_7, SEG_8, SEG_9


Reset:
    ; Инициализация стека
    ldi r16, high(RAMEND)
    out SPH, r16
    ldi r16, low(RAMEND)
    out SPL, r16

	; Инициализация портов
    rcall INIT_PORTS

	; Инициализация переменных
	rcall INIT_VARIABLES

	; Инициализация прерываний
	rcall INIT_INTERRUPTS
	
	; Разрешение прерываний
	sei
MAIN_LOOP:
			
	; Обработка нажатой кнопки
BUTTON:
	sbrs rFlags, flag_bnt ;Пропустить следующую команду если бит в регистре стоит
    rjmp SLEEP_ALL		;убрал на время проверки NEED_RECORD_TIME
	cbr rFlags, (1<<flag_bnt) ; СРАЗУ сбрасываем флаг
	rcall ACTIV_BUTTON

	
SLEEP_ALL:	
	; Режим сна
	 sleep                 ; Перевести МК в режим энергосбережения
   
  	rjmp MAIN_LOOP

 

; =========== Инициализация переменных ===========
INIT_VARIABLES:
	 clr r1 ; R1: Всегда 0x00 (ускоряет очистку регистров и портов)

		; Флаги
     clr rflags
	 
	 ; Нужно 3 стабильных считывания (30 мс)
	 ldi r16, 3
	 mov rDebounce, r16

	 ldi r16, 0xF0
	 mov rbtn_last, r16		; Считаем, что изначально кнопки отпущены (т.е. входы подтянуты внешними резисторами)
	 mov rbtn_now, r16
	 mov rbtn_stat, r16
	 ret

; =========== Инициализация портов ===========
INIT_PORTS:

	; Порты подключенных кнопок как входы и PD3 для INT1, без подтяжки (внешние резисторы на 5в)
    ldi r16, (0<<BTN1)|(0<<BTN2)|(0<<BTN3)|(0<<BTN4)|(0<<BTN_INT); BTN1 это PD7, BTN2 это PD6, BTN3 это PD5, BTN4 это PD4, BTN_INT это PD3
    out BTN_DDR, r16

	; Для теста
	ldi r16, (1<<PB0)|(1<<PB1)|(1<<PB2)|(1<<PB3)|(1<<PB4)|(1<<PB5)
    out DDRB, r16
    
    ret


; =========== Инициализация прерываний ===========
INIT_INTERRUPTS:
	; INT1 - прерывание от кнопок по нажатию 
    ; (нажатие = 1->0 на INT1, отпускание = 0->1)
    ldi r16, (1<<ISC11)|(0<<ISC10)  ; нажатие = 1->0
    out MCUCR, r16
	; ВКЛЮЧИТЬ INT1 (установить бит INT1, сохранив INT0)
	in  r16, GICR        ; Читаем текущее состояние
	ori r16, (1<<INT1)   ; Устанавливаем только бит INT1 (Разрешение INT1)
	out GICR, r16        ; Записываем обратно, включаем INT1

	; Разрешаем прерывание по переполнению Таймера 0
    in r16, TIMSK
    ori r16, (1 << TOIE0)
    out TIMSK, r16
    ret


;==================== Прерывания ===============================

INT1_ISR:
	push r16             ; Сохраняем рабочий регистр
	in r16, SREG         ; Сохраняем статус
	push r16

	; ВЫКЛЮЧИТЬ INT1, чтобы не частил (сбросить бит INT1, сохранив INT0)
	in  r16, GICR			; Читаем текущее состояние прерываний
	andi r16, ~(1<<INT1)	; Сбрасываем только бит INT1 (это способ создать маску для инвертирования нужного бита в регистре микроконтроллера)
	out GICR, r16			; Выключаем INT1
	
	; Запуск Таймера 0
	/*; Устанавливаем предделитель (для 10мс)
	Частота МК: 1 000 000 Гц.
	Максимальный предделитель: 1024.
	Частота таймера: 1000000/1024=976,5 Гц.
	Период одного тика: =1,024 мс.
	Количество тиков для 10 мс: 10/1,024=9,76.
	10 мс — это почти ровно 10 тиков таймера при предделителе 1024.
	Это дает погрешность около 2.4% (реально будет 10.24 мс), что для кнопок абсолютно не критично.
	Чтобы таймер срабатывал каждые 10 тиков, мы будем использовать прерывание по переполнению (OVF) и при каждом входе догружать в счетчик значение, чтобы он быстрее добегал до 256.
 	Расчет: 256-10=246  (0xF6).*/
	;ldi r16, 246        ; Заряжаем на 10 тиков до переполнения
	ldi r16, 246
    out TCNT0, r16
    ldi r16, (1<<CS02)|(0<<CS01)|(1<<CS00) ; Предделитель 1024 (Запуск)
    out TCCR0, r16

	pop r16
	out SREG, r16        ; Восстанавливаем статус
	pop r16

	reti

.include "button.asm"



