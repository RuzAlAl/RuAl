/*
 * initialization.asm
 *
 *  Created: 02.02.2026 16:11:17
 *   Author: ar_user
 */ 
 ; =========== Инициализация переменных ===========
INIT_VARIABLES:
	clr r1 ; R1: Всегда 0x00 (ускоряет очистку регистров и портов)
    clr r5	; Используем в прерывании INT0 для сохранения SREG
	clr r6	; Используем в прерывании INT1 для сохранения SREG
	clr r7	; Используем в прерывании TIMER0 OVF для сохранения SREG
	clr r8	; Счетчик антидребезга
	clr r9  ; Счетчик длительности звука (в младших регистрах)
	clr r21	; Индекс нажатой кнопки
	
	; Флаги
     clr rflags ; регистр r23
	     
    ; Режимы
	ldi r16,0
	sts edit_mode, r16

	ldi r16,0
	sts display_mode, r16
	

	;ldi r16,0x9A ; на индикаторе - 102
	;ldi r16,0x74
	clr r16
	sts i2c_crystal, r16

	ret

; =========== Инициализация портов ===========
INIT_PORTS:
    
	; SPI порты (MOSI, SCK, SS, OE, MR как выходы) и BEEPER_PIN
    ldi r16, (1<<DATA)|(1<<SCK)|(1<<LATCH)|(1<<OE)|(1<<BEEPER_PIN)|(1<<PB7)
    out SPI_DDR, r16
    
   /* ; OE (яркость) - низкий уровень по умолчанию (максимальная яркость)
    cbi SPI_PORT, OE*/

	; OE (ШИМ) - низкий уровень по умолчанию (максимальная яркость)    
	    
    ; Порт для DS3231 (INT0)
    cbi DDRD, DS3231_INT      ; Вход
    sbi PORTD, DS3231_INT     ; Подтяжка
    
    ; Порты для I2C
    cbi DDRC, SDA             ; SDA - вход
    cbi DDRC, SCL             ; SCL - вход
    sbi PORTC, SDA            ; Подтяжка
    sbi PORTC, SCL            ; Подтяжка

	; Порты подключенных кнопок как входы и PD3 для INT1, без подтяжки (внешние резисторы на 5в)
    ldi r16, (0<<BTN1)|(0<<BTN2)|(0<<BTN3)|(0<<BTN4)|(0<<BTN_INT); BTN1 это PD7, BTN2 это PD6, BTN3 это PD5, BTN4 это PD4, BTN_INT это PD3
    out BTN_DDR, r16
    
    ret

; =========== Инициализация ШИМ ===========
INIT_PWM:
	; Настройка TCCR1A:
    ; COM1A1=1, COM1A0=0 -> Clear OC1A on Compare Match (неинвертированный ШИМ)
    ; WGM10=1, WGM11=0 -> Режим Fast PWM, 8-bit
    ldi r16, (1 << COM1A1) | (1 << WGM10)
    out TCCR1A, r16

    ; Настройка TCCR1B:
    ; WGM12=1 -> Дополнение для Fast PWM, 8-bit
    ; CS10=1  -> Предделитель = 1, частота 1МГц/256 = 3906 Гц (запуск таймера)
    ldi r16, (1 << WGM12) | (1 << CS10)
    out TCCR1B, r16


	; Установка начальной яркости (0 - макс, 255 - мин, т.к. OE инверсный)
	;Для записи 16-битного значения старший байт должен быть записан перед младшим.
	;Для чтения 16-битного значения младший байт должен быть прочитан перед старшим.
    ;ldi r16, 128 ; 50% яркости
	clr r16
    out OCR1AH, r16 ; Старший байт в 8-битном режиме всегда 0
	ldi r16, 200
    out OCR1AL, r16
    
    ret

; =========== Инициализация АЦП ===========
INIT_ADC:
	; REFS0=1 (Опорное напряжение AVCC)
    ; ADLAR=1 (Левое выравнивание результата - читаем только ADCH)
    ; MUX3..0=0 (Канал ADC0 / PC0)
    ldi r16, (1 << REFS0) | (1 << ADLAR)
    out ADMUX, r16

    ; ADEN=1 (Вкл АЦП), ADPS1..0=1 (Делитель 8 для точности на 1МГц)
    ldi r16, (1 << ADEN) | (1 << ADPS1) | (1 << ADPS0)
    out ADCSRA, r16
	
	ret  

; =========== Инициализация прерываний ===========
INIT_INTERRUPTS:
	/*ISC01 ISC00 Описание
	0 		0 Низкий уровень INT0 генерирует запрос прерывания.
	0 		1 Любое логическое изменение на INT0 генерирует запрос прерывания.
	1 		0 Спадающий фронт INT0 генерирует запрос прерывания.
	1 		1 Восходящий фронт INT0 генерирует запрос прерывания.*/
    ; INT0 - От DS3231 восходящий фронт генерирует запрос прерывания
    ldi r16, (1<<ISC01)|(0<<ISC00)
    out MCUCR, r16
    ldi r16, (1<<INT0)
    out GICR, r16

	; INT1 - прерывание от кнопок по нажатию 
    ; (нажатие = 1->0 на INT1, отпускание = 0->1)
   in r16, MCUCR
    ;ldi r16, (1<<ISC11)|(0<<ISC10)  ; нажатие = 1->0 по спаду (Falling Edge)
	ori r16, (1<<ISC11)|(0<<ISC10)  ; нажатие = 1->0 по спаду (Falling Edge) добавляем два бита
    out MCUCR, r16
	; ВКЛЮЧИТЬ INT1 (установить бит INT1, сохранив INT0)
	in  r16, GICR        ; Читаем текущее состояние
	ori r16, (1<<INT1)   ; Устанавливаем только бит INT1 (Разрешение INT1)
	out GICR, r16        ; Записываем обратно, включаем INT1

	; Разрешаем прерывание по переполнению Таймера 0
    in r16, TIMSK
    ori r16, (1 << TOIE0)
    out TIMSK, r16
    
    ret